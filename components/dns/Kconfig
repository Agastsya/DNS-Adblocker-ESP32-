## components/dns/Kconfig
```kconfig
menu "PocketDNS DNS / Schedules"

    config POCKETDNS_TIMEZONE
        string "POSIX timezone string (for parental-control schedules)"
        default "UTC0"
        help
            POSIX TZ string used to evaluate time-of-day blocking
            schedules in local time. Examples:
              India:        IST-5:30
              US Eastern:   EST5EDT,M3.2.0,M11.1.0
              UK:           GMT0BST,M3.5.0/1,M10.5.0
            Default UTC0 means schedules are evaluated in UTC.

endmenu
```

## components/web/Kconfig
```kconfig
menu "PocketDNS Web Dashboard"

    config POCKETDNS_WEB_AUTH_ENABLE
        bool "Require HTTP Basic Auth for the dashboard"
        default y
        help
            When enabled, the web dashboard and REST API require a
            username and password (HTTP Basic Auth). Recommended so that
            anyone on your LAN can't change settings.

    config POCKETDNS_WEB_AUTH_USER
        string "Dashboard username"
        depends on POCKETDNS_WEB_AUTH_ENABLE
        default "admin"

    config POCKETDNS_WEB_AUTH_PASSWORD
        string "Dashboard password"
        depends on POCKETDNS_WEB_AUTH_ENABLE
        default "pocketdns"
        help
            Stored in sdkconfig (gitignored). Change this from the
            default before deploying.

endmenu
```

## components/wifi/Kconfig
```kconfig
menu "PocketDNS Configuration"

    config POCKETDNS_WIFI_SSID
        string "Wi-Fi SSID"
        default ""
        help
            Name of the Wi-Fi network PocketDNS should join.

    config POCKETDNS_WIFI_PASSWORD
        string "Wi-Fi Password"
        default ""
        help
            WPA2 passphrase for the network above. This is stored in
            sdkconfig, which is gitignored - fine for a personal device,
            don't commit it if you ever drop that rule.

    config POCKETDNS_WIFI_MAXIMUM_RETRY
        int "Maximum connection retry attempts"
        default 5
        help
            How many times to retry connecting before giving up and
            continuing to boot without Wi-Fi.

    config POCKETDNS_STATIC_IP_ENABLE
        bool "Use a static IP instead of DHCP"
        default n
        help
            DHCP can hand this device a different address after a reboot
            or lease renewal, which silently breaks any bookmark/DNS
            setting pointed at the old IP. Enable this to always use the
            same fixed address instead. (http://pocketdns.local/ via mDNS
            also solves this without needing a static IP - this is for
            networks/clients where that's not convenient.)

    config POCKETDNS_STATIC_IP
        string "Static IP address"
        default "192.168.0.102"
        depends on POCKETDNS_STATIC_IP_ENABLE

    config POCKETDNS_STATIC_GATEWAY
        string "Gateway IP address"
        default "192.168.0.1"
        depends on POCKETDNS_STATIC_IP_ENABLE

    config POCKETDNS_STATIC_NETMASK
        string "Subnet mask"
        default "255.255.255.0"
        depends on POCKETDNS_STATIC_IP_ENABLE

endmenu
```

## sdkconfig.defaults
```kconfig
# ==========================================================================
# PocketDNS - default build configuration
#
# sdkconfig.defaults is applied when the build system first generates your
# sdkconfig. It lets us ship sane, reproducible defaults in git instead of
# forcing every cloner to fiddle with `idf.py menuconfig`.
#
# (sdkconfig itself is machine-generated and should be gitignored.)
# ==========================================================================

# --- Target chip -----------------------------------------------------------
# Also run `idf.py set-target esp32` once; this line keeps it consistent.
CONFIG_IDF_TARGET="esp32"

# --- Flash size: DevKit V1 is almost always 4 MB --------------------------
CONFIG_ESPTOOLPY_FLASHSIZE_4MB=y
CONFIG_ESPTOOLPY_FLASHSIZE="4MB"

# --- Use our custom partition map (partitions.csv) ------------------------
CONFIG_PARTITION_TABLE_CUSTOM=y
CONFIG_PARTITION_TABLE_CUSTOM_FILENAME="partitions.csv"

# --- Flash + UART safety ---------------------------------------------------
# The LittleFS port warns: when UART logging and flash access happen at the
# same time, the UART ISR must live in IRAM or you can get rare corruption.
# Cheap insurance, enable it now.
CONFIG_UART_ISR_IN_IRAM=y

# --- Logging ---------------------------------------------------------------
CONFIG_LOG_DEFAULT_LEVEL_INFO=y

# --- FreeRTOS: give app_main room to grow as we add modules ----------------
CONFIG_ESP_MAIN_TASK_STACK_SIZE=8192

# --- lwIP: bigger UDP receive mailbox --------------------------------------
# A browser opens dozens of DNS lookups at once when loading a page. The
# default 6-deep UDP mailbox overflows under that burst and silently drops
# queries, which shows up as "some sites just keep loading". The DNS server
# also uses a worker pool to drain this fast, but give the kernel headroom.
CONFIG_LWIP_UDP_RECVMBOX_SIZE=32

# More socket descriptors: UDP listener + per-worker upstream forwards + the
# TCP DNS listener and its connections + the web server can run concurrently.
# Raised from 16: with several devices on the network each polling the
# dashboard, the old budget left too little room for the HTTP server's own
# connections (see web_server.c max_open_sockets) and caused it to refuse or
# drop connections under load - "works sometimes, doesn't work sometimes".
CONFIG_LWIP_MAX_SOCKETS=24

# ==========================================================================
#  >>> EDIT THESE TWO LINES with your home Wi-Fi, then build & flash. <<<
#
#  This is the simplest way to set Wi-Fi: just type your network name and
#  password between the quotes below. (If you leave them blank, the device
#  instead starts its own "PocketDNS-Setup" Wi-Fi hotspot on first boot so
#  you can enter them from your phone - no rebuild needed. See the README.)
# ==========================================================================
CONFIG_POCKETDNS_WIFI_SSID=""
CONFIG_POCKETDNS_WIFI_PASSWORD=""

# --- Your timezone, for parental-control schedules (POSIX TZ string) -------
#  Examples:  India "IST-5:30"   UK "GMT0BST,M3.5.0/1,M10.5.0"
#             US East "EST5EDT,M3.2.0,M11.1.0"   UTC "UTC0"
#  (You can also change this later from the dashboard's Settings.)
CONFIG_POCKETDNS_TIMEZONE="UTC0"
```
